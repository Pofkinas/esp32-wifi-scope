/**********************************************************************************************************************
 * Includes
 *********************************************************************************************************************/

#include "voltage_api.h"

#if defined(ENABLE_VOLTAGE)
#include "debug_api.h"
#include "adc_driver.h"

/**********************************************************************************************************************
 * Private definitions and macros
 *********************************************************************************************************************/

/**********************************************************************************************************************
 * Private typedef
 *********************************************************************************************************************/

/**********************************************************************************************************************
 * Private constants
 *********************************************************************************************************************/

/**********************************************************************************************************************
 * Private variables
 *********************************************************************************************************************/

static bool g_is_adc_calibrated[eAdc_Last] = {false};

/**********************************************************************************************************************
 * Exported variables and references
 *********************************************************************************************************************/

/**********************************************************************************************************************
 * Prototypes of private functions
 *********************************************************************************************************************/

/**********************************************************************************************************************
 * Definitions of private functions
 *********************************************************************************************************************/

/**********************************************************************************************************************
 * Definitions of exported functions
 *********************************************************************************************************************/

bool Voltage_API_Init(const eAdc_t adc) {
    if (!ADC_Config_IsCorrectAdc(adc)) {
        return false;
    }

    if (g_is_adc_calibrated[adc]) {
        return true;
    }

    if (!ADC_Driver_Calibrate(adc)) {
        return false;
    }

    g_is_adc_calibrated[adc] = true;

    return true;
}

bool Voltage_API_Process(uint32_t *raw_data, void *out_data, size_t elements, const void *context) {
    if ((NULL == out_data) || (NULL == context)) {
        return false;
    }

    sAdcConfig_t *desc = (sAdcConfig_t *) context;

    uint32_t processed_data = 0;

    for (size_t i = 0; i < elements; i++) {
        if (!ADC_Driver_GetCalibrationVoltage(desc->adc, desc->channel, raw_data[i], &processed_data)) {
            return false;
        }

        // Reuse raw_data buffer to store processed voltage values
        ((uint16_t *) raw_data)[i] = (uint16_t) processed_data;
    }

    *(uint16_t **) out_data = (uint16_t *) raw_data;

    return true;
}

#endif /* ENABLE_VOLTAGE */